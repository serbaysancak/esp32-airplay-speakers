## firmware/components/hk_airplay/Kconfig
```kconfig
menu "Harman Kardom AirPlay"

config HK_AIRPLAY
    bool "Build the vendored AirPlay 2 receiver (ADR-0007)"
    default n
    help
        Compile and link the AirPlay receiver vendored under
        components/hk_airplay/vendor at the commit ADR-0007 pins.

        Off by default. The receiver drives I2S, and on the product board that
        is not allowed until the driver-protection gates (G0/G2) have produced
        a calibration profile -- hk_airplay_start() refuses in that case anyway,
        but leaving the code out entirely keeps the product image and its size
        budget unchanged until the decision is actually made.

        The upstream licence is non-commercial. Enabling this binds the whole
        firmware to those terms; see ADR-0007.

if HK_AIRPLAY

# --- Values the vendored sources read.
#
#     Declared here rather than by vendoring upstream's Kconfig, so that
#     vendor/ stays byte-identical to upstream and the settings this project
#     actually made are visible in one file instead of buried in a 523-line
#     menu describing boards, displays and amplifiers that do not exist here.

config I2S_BCK_IO
    int "I2S bit clock GPIO"
    default 4
config I2S_WS_IO
    int "I2S word select GPIO"
    default 5
config I2S_DO_IO
    int "I2S data output GPIO"
    default 6
config I2S_SCK_IO
    int "I2S master clock GPIO (-1 for none)"
    default -1
    help
        No master clock. The PCM5102A of ADR-0002 recovers its clock with an
        internal PLL, so an MCLK line would be a pin spent on nothing.
config I2S_VCC_IO
    int "GPIO used to power a DAC module (-1 for none)"
    default -1
config I2S_GND_IO
    int "GPIO used as a DAC module ground (-1 for none)"
    default -1
    help
        Upstream supports small DAC breakout boards powered from spare GPIOs.
        This design powers the DAC from the supply rail, so both are -1.

choice HK_AIRPLAY_OUTPUT
    prompt "Where the receiver sends audio"
    default HK_AIRPLAY_OUTPUT_I2S

config HK_AIRPLAY_OUTPUT_I2S
    bool "I2S to the PCM5102A (the product's output, ADR-0002)"

config HK_AIRPLAY_OUTPUT_SPDIF
    bool "Coaxial S/PDIF, bit-banged through I2S"
    help
        A bench output, not a product one. It exists so audio can be HEARD
        before the PCM5102A modules arrive: the receiver's decode, clock and
        timing are all exercised, and an external DAC does the conversion.

        Only the data pin carries signal; no bit or word clock is emitted. It
        needs three passive parts between the GPIO and the coax centre, because
        S/PDIF wants 0.5 V into 75 ohm and a GPIO swings 3.3 V:

            GPIO --[210R]--+--[100nF]-- coax centre
                           |
                         [110R]
                           |
            GND -----------+---------- coax shield

        Loaded by a 75 ohm input that yields 0.58 Vpp, inside the 0.5 V +/-20%
        the standard allows, with a source impedance of 72 ohm. Driving the
        cable straight from the GPIO is out of spec in both.

endchoice

config SPDIF_DO_IO
    int
    depends on HK_AIRPLAY_OUTPUT_SPDIF
    default 6
    help
        Not a free choice: it must be the pin ADR-0011 reserved for audio data,
        and hk_airplay.c asserts that at compile time. S/PDIF replaces the I2S
        output rather than joining it, so it belongs on the same pin.

config OUTPUT_SAMPLE_RATE_HZ
    int
    default 44100
    help
        AirPlay's own rate. Resampling would cost CPU and quality to arrive at
        a rate nothing here needs.

config RESAMPLER_TAPS
    int
    default 28

config AIRPLAY_TIMING_THRESHOLD_MS
    int
    default 25
config AIRPLAY_RT_TIMING_THRESHOLD_MS
    int
    default 50

config AIRPLAY_FORCE_V1
    bool "Advertise AirPlay 1 only"
    default n
    help
        Off: the receiver offers AirPlay 2, which is what PRD-002 needs for
        multiroom. ADR-0007 keeps this switch as the documented retreat if the
        G7 synchronisation measurement fails.

config ENABLE_AIRPLAY_ARTWORK
    bool "Receive cover art"
    default n
    help
        Off. There is no display, so artwork would be received and dropped --
        paid for in the memory budget the jitter buffer needs.

endif

endmenu
```

## firmware/main/Kconfig.projbuild
```kconfig
menu "Harman Kardom board"

config HK_BOARD_DEVKIT_N8R2
    bool "Build for the ESP32-S3 N8R2 development kit"
    default n
    help
        Build for the bring-up devkit on the bench (8 MB flash, 2 MB quad PSRAM)
        instead of the N16R8 product board of ADR-0010.

        This is not a product configuration. It changes the OTA hardware revision
        from "prototype-n16r8" to "devkit-n8r2" so that a manifest published for
        one board is refused by the other, and firmware/CMakeLists.txt refuses to
        build it with application signing enabled so it can never be published.

        Leave this off unless you are flashing the devkit. Setting it by hand
        without also selecting the 8 MB flash size and the devkit partition table
        is a configure-time error, not something you discover on the bench.

config HK_DEVKIT_STATUS_LED
    bool "Mirror the status LED onto the devkit's on-board addressable LED"
    depends on HK_BOARD_DEVKIT_N8R2
    default y
    help
        The product board's indicator is three PWM channels driving an external
        RGB LED (ADR-0011). A bare devkit has nothing on those pins, so it shows
        no status at all -- every state has to be read off the serial console.

        This mirrors exactly what those channels are told to do onto the single
        addressable LED the devkit already carries. It is a mirror, not a second
        indicator: the colour comes from the same render pass, so the two cannot
        disagree about what the device is doing.

config HK_DEVKIT_STATUS_LED_GPIO
    int "GPIO of the devkit's on-board addressable LED"
    depends on HK_DEVKIT_STATUS_LED
    default 48
    help
        48 on ESP32-S3-DevKitC-1 v1.1 and later, 38 on some earlier boards and
        on several third-party clones. If the LED stays dark, this is the first
        thing to check.

config HK_DEVKIT_FIRST_BOOT_BLE
    bool "Open BLE instead of SoftAP when the devkit has no credentials"
    depends on HK_BOARD_DEVKIT_N8R2
    default y
    help
        ADR-0005 sends a device with nothing stored to SoftAP, and one that
        already works to BLE on a button press. The devkit has no button, so
        under that rule its BLE transport can never be reached, and a transport
        that cannot be reached cannot be tested.

        Turn this off to exercise the SoftAP path on the devkit instead. It
        changes nothing on the product board.

config HK_DEVKIT_WIFI_SSID
    string "Bench Wi-Fi SSID to preload (empty: do not preload)"
    depends on HK_BOARD_DEVKIT_N8R2
    default ""
    help
        A convenience for the bench, and only for the bench.

        The devkit has no button, so the 5-second press that clears credentials
        cannot be given, and joining its SoftAP from the machine driving the
        board would drop that machine off the network it is being told to join.
        This lets the board be put on a network over USB instead.

        Put the value in firmware/sdkconfig.devkit.local, which is ignored by
        git. Do not put it in sdkconfig.devkit: that file is committed, and this
        one carries somebody's actual Wi-Fi password.

        Empty means preload nothing, which is the default and the only setting
        that should ever be committed. Existing stored credentials are never
        overwritten.

config HK_DEVKIT_WIFI_PASSWORD
    string "Bench Wi-Fi password to preload (empty: do not preload)"
    depends on HK_BOARD_DEVKIT_N8R2
    default ""
    help
        See HK_DEVKIT_WIFI_SSID. This is a real password: it ends up in the
        built image, which is why it is confined to the bench board and to a
        file that is never committed.

endmenu
```
